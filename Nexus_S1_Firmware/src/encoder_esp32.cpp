#include "encoder_config.h"
#if NEXUS_ENCODER_PREVIEW
#include <Arduino.h>
#include <soc/gpio_struct.h>
#include "encoder_core.h"
#include "encoder_esp32.h"
#include "ui.h"
#include "touch_config.h"
#include "touch_spi_diag.h"
#include "touch_esp32.h"
static_assert(!NEXUS_TOUCH_LIVE_PREVIEW && NEXUS_TOUCH_RAW_EXPERIMENT==0 &&
              !NEXUS_TOUCH_SPI_FREEZE_TFT,"Encoder preview requires RAW A and live TFT refresh");
namespace {
using namespace nexus_encoder;
portMUX_TYPE encoder_mux=portMUX_INITIALIZER_UNLOCKED;
Quadrature rotation(NEXUS_ENCODER_EDGES_PER_STEP);
Button button;
TaskHandle_t owner=nullptr;
bool initialized=false,pulse=false;
uint8_t clicks=0;
int32_t remaining=0;
volatile uint32_t irq_count=0;
struct Diagnostics {
    uint32_t decoded_plus=0,decoded_minus=0,lv_plus=0,lv_minus=0,reads=0;
    uint32_t sw_edges=0,shorts=0,backs=0,resets=0,last_sent=0,last_attempt=0;
    bool config_sent=false,attempted=false,raw_known=false,last_raw=false;
} diagnostic;
uint8_t IRAM_ATTR phase() {
    const uint32_t pins=GPIO.in; // One coherent register read, pins 1/2 are both below 32.
    return uint8_t((((pins>>pin_a)&1)<<1)|((pins>>pin_b)&1));
}
void IRAM_ATTR edge() {
    portENTER_CRITICAL_ISR(&encoder_mux);
    ++irq_count; // Observation only; no printing or LVGL in the ISR.
    rotation.edge(phase()); // Only arithmetic/state under a short ISR spinlock.
    portEXIT_CRITICAL_ISR(&encoder_mux);
}
void resetInput() {
    ++diagnostic.resets;
    portENTER_CRITICAL(&encoder_mux);rotation.reset(phase());portEXIT_CRITICAL(&encoder_mux);
    clicks=0;remaining=0;pulse=false;
    button.begin(digitalRead(pin_sw)==LOW,millis()); // Require stable release after navigation/rebind.
}
void readEncoder(ui_encoder_data_t* data) {
    if(!initialized || xPortInIsrContext() || xTaskGetCurrentTaskHandle()!=owner)return;
    portENTER_CRITICAL(&encoder_mux);const int16_t steps=rotation.take();portEXIT_CRITICAL(&encoder_mux);
    ++diagnostic.reads;
    if(steps>0)diagnostic.decoded_plus+=uint32_t(steps);
    else diagnostic.decoded_minus+=uint32_t(-int32_t(steps));
    remaining+=int32_t(steps)*NEXUS_ENCODER_DIRECTION;
    if(remaining>1024)remaining=1024;
    if(remaining<-1024)remaining=-1024;
    // Classify the physical SW gesture first. A short gesture generates one
    // PR/REL pair on separate LVGL polls; a long gesture never generates ENTER.
    if(pulse) { pulse=false;return; }
    // A detent queued before this press must move focus BEFORE ENTER. Otherwise
    // coalesced rotation+SW input can activate the previously selected button.
    if(clicks && !remaining) { --clicks;pulse=true;data->pressed=true;return; }
    // Keep focus fixed through the synthetic PR/REL pair generated by the real
    // short gesture; buffer any simultaneous rotation until the pair completes.
    data->diff=int16_t(remaining>16?16:remaining<-16?-16:remaining);remaining-=data->diff;
    if(data->diff>0)diagnostic.lv_plus+=uint32_t(data->diff);
    else diagnostic.lv_minus+=uint32_t(-int32_t(data->diff));
}
void reportDiagnostic() {
    const uint32_t now=millis();
    // At most one accepted line/second; a busy CDC queue is retried at most
    // every 50ms, without waiting. This also handles millis() wrap.
    if((diagnostic.config_sent && uint32_t(now-diagnostic.last_sent)<1000U) ||
       (diagnostic.attempted && uint32_t(now-diagnostic.last_attempt)<50U))return;
    diagnostic.attempted=true;diagnostic.last_attempt=now;
    char line[256];int length;
    if(!diagnostic.config_sent) {
        length=snprintf(line,sizeof(line),
            "ENC CFG env=encoder_preview init=%u A=%d B=%d SW=%d input=PULLUP SW_active=LOW debounce_ms=%lu common=GND edges_per_step=%u direction=%d HID_OFF=%u\n",
            unsigned(initialized),pin_a,pin_b,pin_sw,(unsigned long)Button::debounce_ms,unsigned(NEXUS_ENCODER_EDGES_PER_STEP),
            NEXUS_ENCODER_DIRECTION,unsigned(NEXUS_HID_OUTPUT_DISABLED));
    } else {
        uint32_t interrupts,invalid;uint8_t ab;
        portENTER_CRITICAL(&encoder_mux);
        interrupts=irq_count;invalid=rotation.invalid();ab=phase();
        portEXIT_CRITICAL(&encoder_mux);
        length=snprintf(line,sizeof(line),
            "ENC RAW ms=%lu init=%u A=%u B=%u SW=%u irq=%lu bad=%lu dec=%lu/%lu lv=%lu/%lu rd=%lu sw=%s arm=%u held=%u edges=%lu click=%lu short=%lu back=%lu reset=%lu\n",
            (unsigned long)now,unsigned(initialized),unsigned(ab>>1),unsigned(ab&1),unsigned(digitalRead(pin_sw)!=LOW),
            (unsigned long)interrupts,(unsigned long)invalid,
            (unsigned long)diagnostic.decoded_plus,(unsigned long)diagnostic.decoded_minus,
            (unsigned long)diagnostic.lv_plus,(unsigned long)diagnostic.lv_minus,(unsigned long)diagnostic.reads,
            button.pressed()?"PRESS":"REL",unsigned(button.armed()),unsigned(button.held()),
            (unsigned long)diagnostic.sw_edges,(unsigned long)button.pressCount(),(unsigned long)diagnostic.shorts,
            (unsigned long)diagnostic.backs,(unsigned long)diagnostic.resets);
    }
    if(length>0 && length<int(sizeof(line)) && tryNexusEncoderDiagnosticLine(line,uint32_t(length))) {
        diagnostic.config_sent=true;diagnostic.last_sent=now;
    }
}
}
bool initNexusEncoder() {
    if(initialized || xPortInIsrContext())return false;
    using namespace nexus_encoder;
    pinMode(pin_a,INPUT_PULLUP);pinMode(pin_b,INPUT_PULLUP);pinMode(pin_sw,INPUT_PULLUP);
    owner=xTaskGetCurrentTaskHandle();resetInput();initialized=true;
    attachInterrupt(pin_a,edge,CHANGE);attachInterrupt(pin_b,edge,CHANGE);
    ui_set_encoder_reader(readEncoder,resetInput); // Reuse ui.cpp's existing encoder, not a second indev.
    return true;
}
void serviceNexusEncoder() {
    if(xPortInIsrContext() || (owner && xTaskGetCurrentTaskHandle()!=owner))return;
    if(!initialized) { reportDiagnostic();return; }
    const bool pressed=digitalRead(nexus_encoder::pin_sw)==LOW;
    if(diagnostic.raw_known && pressed!=diagnostic.last_raw)++diagnostic.sw_edges;
    diagnostic.raw_known=true;diagnostic.last_raw=pressed;
    button.update(pressed,millis());
    const auto action=button.take();
    if(action==nexus_encoder::Action::Click) { ++diagnostic.shorts;if(clicks<4)++clicks; }
    else if(action==nexus_encoder::Action::Back) {
        ++diagnostic.backs;
        resetInput();ui_encoder_back(); // UI task only; cancel pending ENTER before navigating.
    }
    reportDiagnostic();
}
#endif
